## sdkconfig.defaults
```kconfig
# ===== COMPILER OPTIMIZATION =====
CONFIG_COMPILER_OPTIMIZATION_SIZE=y
CONFIG_COMPILER_CXX_EXCEPTIONS=y
CONFIG_COMPILER_CXX_EXCEPTIONS_EMG_POOL_SIZE=1024
CONFIG_COMPILER_CXX_RTTI=y

# ===== BOOTLOADER =====
CONFIG_BOOTLOADER_COMPILER_OPTIMIZATION_PERF=y
CONFIG_BOOTLOADER_LOG_LEVEL_NONE=y
CONFIG_BOOTLOADER_SKIP_VALIDATE_ALWAYS=y
CONFIG_BOOTLOADER_APP_ROLLBACK_ENABLE=y

# ===== HTTPD =====
CONFIG_HTTPD_MAX_REQ_HDR_LEN=2048
CONFIG_HTTPD_MAX_URI_LEN=2048

# ===== PARTITION TABLE =====
CONFIG_ESPTOOLPY_FLASHSIZE_16MB=y
CONFIG_PARTITION_TABLE_CUSTOM=y
CONFIG_PARTITION_TABLE_CUSTOM_FILENAME="partitions/v2/16m.csv"
CONFIG_PARTITION_TABLE_OFFSET=0x8000

# ===== FREERTOS =====
CONFIG_ESP_TASK_WDT_TIMEOUT_S=10
CONFIG_FREERTOS_GENERATE_RUN_TIME_STATS=y
CONFIG_FREERTOS_USE_STATS_FORMATTING_FUNCTIONS=y

# ===== ESP SYSTEM =====
CONFIG_ESP_MAIN_TASK_STACK_SIZE=8192

# ===== MBEDTLS =====
CONFIG_MBEDTLS_DYNAMIC_BUFFER=y
CONFIG_MBEDTLS_SSL_KEEP_PEER_CERTIFICATE=n
CONFIG_MBEDTLS_CERTIFICATE_BUNDLE_CROSS_SIGNED_VERIFY=y
CONFIG_MBEDTLS_SSL_RENEGOTIATION=n

# ===== WIFI =====
CONFIG_ESP_WIFI_IRAM_OPT=n
CONFIG_ESP_WIFI_RX_IRAM_OPT=n
CONFIG_ESP_WIFI_DYNAMIC_RX_MGMT_BUFFER=y
CONFIG_ESP_WIFI_STATIC_RX_BUFFER_NUM=6
CONFIG_ESP_WIFI_DYNAMIC_RX_BUFFER_NUM=8
CONFIG_ESP_WIFI_ENTERPRISE_SUPPORT=n

# ===== NEWLIB =====
CONFIG_NEWLIB_NANO_FORMAT=y

# ===== CODEC =====
CONFIG_CODEC_I2C_BACKWARD_COMPATIBLE=n

# ===== UART =====
CONFIG_UART_ISR_IN_IRAM=y

# ===== LVGL =====
CONFIG_LV_OS_NONE=y
CONFIG_LV_USE_CLIB_MALLOC=y
CONFIG_LV_USE_CLIB_STRING=y
CONFIG_LV_USE_CLIB_SPRINTF=y
CONFIG_LV_USE_IMGFONT=y
CONFIG_LV_USE_ASSERT_STYLE=y
CONFIG_LV_FONT_FMT_TXT_LARGE=y
CONFIG_LV_USE_FONT_COMPRESSED=n
CONFIG_LV_USE_FONT_PLACEHOLDER=n
CONFIG_LV_USE_LODEPNG=y
CONFIG_LV_USE_ANIMIMG=n
CONFIG_LV_USE_CALENDAR=n
CONFIG_LV_USE_CALENDAR_HEADER_ARROW=n
CONFIG_LV_USE_CALENDAR_HEADER_DROPDOWN=n
CONFIG_LV_USE_CHART=n
CONFIG_LV_USE_KEYBOARD=n
CONFIG_LV_USE_LED=n
CONFIG_LV_USE_LIST=n
CONFIG_LV_USE_MENU=n
CONFIG_LV_USE_MSGBOX=n
CONFIG_LV_USE_SPAN=n
CONFIG_LV_USE_SPINBOX=n
CONFIG_LV_USE_SPINNER=n
CONFIG_LV_USE_TABVIEW=n
CONFIG_LV_USE_TILEVIEW=n
CONFIG_LV_USE_WIN=n
CONFIG_LV_BUILD_EXAMPLES=n
CONFIG_LV_BUILD_DEMOS=n

# ===== BOARD CONFIGURATION =====
CONFIG_BOARD_TYPE_WK_ESP32S3_DEV=y
CONFIG_LANGUAGE_VI_VN=y
CONFIG_WK_ESP32S3_DEV_DISPLAY_OLED=y
CONFIG_DISPLAY_OLED_TYPE_SSD1306_128X64=y

# ===== MOTOR =====
CONFIG_BOARD_WK_HAVE_MOTOR=y

# ===== WAKE WORD - DISABLE TO AVOID ERRORS =====
CONFIG_WAKE_WORD_DISABLED=y
CONFIG_USE_CUSTOM_WAKE_WORD=n
CONFIG_USE_AFE_WAKE_WORD=n
CONFIG_USE_ESP_WAKE_WORD=n

# ===== AUDIO PROCESSOR - DISABLE =====
CONFIG_USE_AUDIO_PROCESSOR=n

# ===== DISABLE ALL I2C CODECS (ES8311, ES8374, ES8388, AW88298) =====
CONFIG_ESP_CODEC_ES8311_ENABLE=n
CONFIG_ESP_CODEC_ES8374_ENABLE=n
CONFIG_ESP_CODEC_ES8388_ENABLE=n
CONFIG_ESP_CODEC_AW88298_ENABLE=n

# ===== DISABLE CAMERA/VIDEO =====
CONFIG_XIAOZHI_ENABLE_CAMERA_DEBUG_MODE=n
CONFIG_XIAOZHI_CAMERA_MIRROR_CONFIGURED=n

# ===== NETWORK =====
CONFIG_ESP_WIFI_SSID=""
CONFIG_ESP_WIFI_PASSWORD=""
CONFIG_OTA_URL="https://api.tenclass.net/xiaozhi/ota/"
```

## sdkconfig.defaults.esp32
```kconfig
CONFIG_ESPTOOLPY_FLASHSIZE_16MB=y
CONFIG_PARTITION_TABLE_CUSTOM_FILENAME="partitions/v2/16m.csv"
CONFIG_SR_WN_WN9_HILILI_TTS=y
CONFIG_ESP_TASK_WDT_TIMEOUT_S=20
```
